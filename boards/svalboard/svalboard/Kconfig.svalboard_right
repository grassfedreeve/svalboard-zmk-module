## boards/svalboard/svalboard/Kconfig.svalboard_right
```kconfig
#
# Copyright (c) 2024 The ZMK Contributors
# SPDX-License-Identifier: MIT
#

config BOARD_SVALBOARD_RIGHT
    select SOC_RP2040 
    select ZMK_USB
    select RP2_FLASH_W25Q080
    select ZMK_BOARD_COMPAT
    imply RETAINED_MEM
    imply RETENTION
    imply RETENTION_BOOT_MODE
```

## boards/svalboard/svalboard/board.yml
```yaml
boards:
 - name: svalboard_left
   vendor: svalboard
   socs:
    - name: rp2040
      variants:
        - name: zmk
 - name: svalboard_right
   vendor: svalboard
   socs:
    - name: rp2040
      variants:
        - name: zmk
```
