## boards/svalboard/svalboard/Kconfig
```kconfig
#
# Copyright (c) 2024 The ZMK Contributors
# SPDX-License-Identifier: MIT
#

config BOARD_SVALBOARD_LEFT
    bool

config BOARD_SVALBOARD_RIGHT
    bool
```

## boards/svalboard/svalboard/Kconfig.defconfig
```kconfig
#
# Copyright (c) 2024 The ZMK Contributors
# SPDX-License-Identifier: MIT
#

if BOARD_SVALBOARD_RIGHT

config ZMK_KEYBOARD_NAME
    default "Svalboard ZMK"

config ZMK_SPLIT_ROLE_CENTRAL
    default y

endif # BOARD_SVALBOARD_LEFT

if BOARD_SVALBOARD_LEFT || BOARD_SVALBOARD_RIGHT

config ZMK_KSCAN_MATRIX_WAIT_BEFORE_INPUTS
    default 90

config ZMK_KSCAN_MATRIX_WAIT_BETWEEN_OUTPUTS
    default 90
    
config BOARD
    default "svalboard"

config ZMK_SPLIT
    default y

config ZMK_SPLIT_WIRED
	default y

config ZMK_SPLIT_WIRED_CMD_BUFFER_ITEMS
	default 30

config ZMK_SPLIT_WIRED_EVENT_BUFFER_ITEMS
	default 30

config SERIAL
    default y

config ZMK_KSCAN_MATRIX_POLLING
    default y

config ZMK_KSCAN_DEBOUNCE_PRESS_MS
    default 0

config ZMK_KSCAN_DEBOUNCE_RELEASE_MS
    default 0

#if ZMK_RGB_UNDERGLOW

#config WS2812_STRIP
#    default y

#endif # ZMK_RGB_UNDERGLOW

endif # BOARD_SVALBOARD_LEFT || BOARD_SVALBOARD_RIGHT
```

## boards/svalboard/svalboard/Kconfig.svalboard_left
```kconfig
#
# Copyright (c) 2024 The ZMK Contributors
# SPDX-License-Identifier: MIT
#

config BOARD_SVALBOARD_LEFT
    select SOC_RP2040 
    select RP2_FLASH_W25Q080
    imply RETAINED_MEM
    imply RETENTION
    imply RETENTION_BOOT_MODE
```

## boards/svalboard/svalboard/svalboard_right_defconfig
```kconfig
# Copyright (c) 2024 The ZMK Contributors
# SPDX-License-Identifier: MIT

CONFIG_USB_DEVICE_MANUFACTURER="Svalboard"
CONFIG_USB_DEVICE_VID=0x303A
CONFIG_USB_DEVICE_PID=0x4044
CONFIG_CLOCK_CONTROL=y

CONFIG_SYS_CLOCK_HW_CYCLES_PER_SEC=125000000

# Enable reset by default
CONFIG_RESET=y

# Flash Settings
CONFIG_USE_DT_CODE_PARTITION=y
CONFIG_MPU_ALLOW_FLASH_WRITE=y
#CONFIG_NVS=y
#CONFIG_SETTINGS_NVS=y
CONFIG_FLASH=y
CONFIG_FLASH_PAGE_LAYOUT=y
CONFIG_FLASH_MAP=y

#CONFIG_ZMK_SPLIT_WIRED_UART_MODE_DEFAULT_POLLING=y
CONFIG_ZMK_SPLIT_WIRED_POLLING_RX_PERIOD=3
CONFIG_MAIN_STACK_SIZE=2048
# Output UF2 by default
CONFIG_BUILD_OUTPUT_UF2=y
CONFIG_SVAL_KSCAN=y
CONFIG_ZMK_KSCAN_SVAL_MATRIX=y
```

## drivers/kscan/Kconfig
```kconfig
if KSCAN

config SVAL_KSCAN
    bool
    default $(dt_compat_enabled,$(DT_COMPAT_ZMK_KSCAN_SVAL_MATRIX))
    select ZMK_KSCAN_GPIO_DRIVER

if SVAL_KSCAN

config ZMK_KSCAN_SVAL_MATRIX_THREAD_PRIORITY
    int "Thread priority"
    default -1
    help
      Priority of thread used by the driver to handle interrupts.

config ZMK_KSCAN_SVAL_MATRIX_THREAD_STACK_SIZE
    int "Thread stack size"
    default 768
    help
      Stack size of thread used by the driver.

endif # SVAL_KSCAN

endif # KSCAN
```
